#include <MD_MAX72xx.h>
#include <Servo.h>
#include <LiquidCrystal.h>
 
#define HARDWARE_TYPE MD_MAX72XX::DR0CR0RR1_HW
#define NUM_OF_MATRIX 2
#define DELAY_ANIMATION 50
#define N_FRAMES 30
#define A_ROWS 8

//Pines:
#define SERVO_PIN 8
#define TRIGGER 13
#define ECHO 12
#define DIN 2
#define CS 3
#define CLK 4

// RS, E, D4, D5, D6, D7
#define RS 0
#define E 1
#define D4 2
#define D5 3
#define D6 4
#define D7 5
const byte pines_LCD1[]{53,51,49,47,45,43};
const byte pines_LCD2[]{52,50,48,46,44,42};

const byte frameDef2[]={0x00,0x00,0x00,0x00,0x00,0x00,0x01,0x01};
const byte frameDef[]={0x00,0x00,0x00,0x00,0x00,0x00,0x80,0x80};

const byte framesAuto[N_FRAMES][A_ROWS]={
  {0x00,0x00,0x00,0x00,0x00,0x00,0x01,0xff},
  {0x00,0x00,0x00,0x00,0x00,0x00,0xf1,0x0f},
  {0x00,0x00,0x00,0x00,0x00,0xc0,0x39,0x07},
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  {0x01,0x01,0x01,0x01,0x01,0x01,0x01,0x01},
//------------------------------------------------
  {0x80,0x80,0x80,0x80,0x80,0x80,0x80,0x80},
  {0x40,0x40,0x40,0x40,0x80,0x80,0x80,0x80},
  {0x20,0x20,0x40,0x40,0x40,0x40,0x80,0x80},
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  {0x00,0x00,0x00,0x00,0x00,0x00,0x80,0xff}
};

float gradoActual=180.0;

//Objetos:
MD_MAX72XX mx = MD_MAX72XX(HARDWARE_TYPE, DIN, CLK, CS, NUM_OF_MATRIX);
Servo ms;
LiquidCrystal lcd1(pines_LCD1[RS],pines_LCD1[E],pines_LCD1[D4],pines_LCD1[D5],pines_LCD1[D6],pines_LCD1[D7]);
LiquidCrystal lcd2(pines_LCD2[RS],pines_LCD2[E],pines_LCD2[D4],pines_LCD2[D5],pines_LCD2[D6],pines_LCD2[D7]);

void setup() {
  Serial.begin(9600);
  pinMode(ECHO,INPUT);
  pinMode(TRIGGER,OUTPUT);
  ms.attach(SERVO_PIN);
  ms.write(0);
  mx.begin(); 
  lcd1.begin(16,2);
  lcd2.begin(16,2);
  testInicial();
  mx.control(MD_MAX72XX::INTENSITY, 5);
}

void loop() {
  delay(DELAY_ANIMATION*2);
  mx.clear();  
  for(int i=0;i<N_FRAMES;i++){
    ms.write(gradoActual);
    if(i<N_FRAMES/2) drawRows(framesAuto[i],frameDef);
    else drawRows(frameDef2,framesAuto[i]);
    // ultraSonido();
    delay(DELAY_ANIMATION);
    gradoActual-=6;
  }  
  gradoActual=180.0;
  ms.write(gradoActual);
}

int ultraSonido(){
  digitalWrite(TRIGGER, LOW); 
  delayMicroseconds(5);
  digitalWrite(TRIGGER, HIGH); 
  delayMicroseconds(10); 
  digitalWrite(TRIGGER, LOW);
  double dur = pulseIn(ECHO, HIGH);
  Serial.print("Dur: ");
  Serial.println(dur);
  double cm = dur*0.017;
  Serial.print("Distancia al objeto: ");
  Serial.print(cm);
  Serial.println(" cm");
  return cm;
}


void drawRows(const byte fig[],const byte fig2[]){
  for( int i = 0; i < 8; i++ ){
    mx.setRow(0, i, fig[i]);
    mx.setRow(1, i, fig2[i]);
  }
}


void testInicial(){
  mx.control(MD_MAX72XX::TEST, true);
  lcd1.print("Hola Mundo");
  lcd2.print("Hola Mundo");
  for(int i=0;i<=100;i++){
    lcd1.setCursor(0,2);
    lcd2.setCursor(0,2);
    lcd1.print("Test: ");
    lcd1.print(i);
    lcd1.print("% :)");
    lcd2.print("Test: ");
    lcd2.print(i);
    lcd2.print("% :)");
    delay(10);
  }
  mx.control(MD_MAX72XX::TEST, false);
}
